/*
 * Copyright 2026 loco-pico contributors
 * SPDX-License-Identifier: Apache-2.0
 *
 * USB CDC-ECM virtual Ethernet interface.
 */

/ {
};

&zephyr_udc0 {
	cdc_ecm_eth0: cdc_ecm_eth0 {
		compatible = "zephyr,cdc-ecm-ethernet";
		remote-mac-address = "00005E005301";
	};
};
